## firmware/v6_clean_30pin_rewrite/sdkconfig.defaults
```kconfig
# Flash size and baud rate
CONFIG_ESPTOOLPY_FLASHSIZE_4MB=y
CONFIG_ESPTOOLPY_BAUD_115200B=y
CONFIG_ESPTOOLPY_MONITOR_BAUD_115200B=y

# FreeRTOS settings for robust operation
CONFIG_FREERTOS_HZ=1000

# Custom Partition Table to make room for OTA and larger apps
CONFIG_PARTITION_TABLE_CUSTOM=y
CONFIG_PARTITION_TABLE_CUSTOM_FILENAME="partitions.csv"
CONFIG_PARTITION_TABLE_FILENAME="partitions.csv"
CONFIG_PARTITION_TABLE_OFFSET=0x8000

# Web server needs enough sockets
CONFIG_LWIP_MAX_SOCKETS=10
CONFIG_HTTPD_MAX_REQ_HDR_LEN=1024
CONFIG_HTTPD_MAX_URI_LEN=512

# NVS
CONFIG_NVS_ENCRYPTION=n
```
